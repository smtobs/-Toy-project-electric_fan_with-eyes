## lobby_phone/package/my_application/Config.in
```kconfig
config BR2_PACKAGE_MY_APPLICATION
	bool "My Application"
	help
	  my application.
```

## lobby_phone/package/my_drivers/Config.in
```kconfig
config BR2_PACKAGE_MY_DRIVERS
	bool "My Drivers"
	help
	  Kernel module to my drivers.
```
